## Documentation/devicetree/bindings/net/semtech,sx1262.yaml
```yaml
# SPDX-License-Identifier: (GPL-2.0-only OR BSD-2-Clause)
%YAML 1.2
---
$id: http://devicetree.org/schemas/net/semtech,sx1262.yaml#
$schema: http://devicetree.org/meta-schemas/core.yaml#

title: Semtech SX1262 raw LoRa transceiver

maintainers:
  - Belousov Oleg <belousov.oleg@gmail.com>

description: |
  SPI mode 0 transceiver. GPIOs may belong to sleeping GPIO expanders.
  NSS is managed by the SPI controller's cs-gpios, never by this binding.
  Multiple radios may share a level-high IRQ through an external diode OR.
  dio1-gpios optionally reads the individual signal before the OR gate.
  The ebyte,e22-x00m30s profile defaults to frequency bounds 410..930 MHz.
  Restrict these to the actual module band, e.g. 410..493 MHz for E22-400M30S.
  Do not use the same SoC GPIO both as an IRQ and as dio1-gpios; the latter
  is intended for a separate tap, e.g. TCA9554 P4.

properties:
  compatible:
    oneOf:
      - const: semtech,sx1262
      - items:
          - const: ebyte,e22-x00m30s
          - const: semtech,sx1262

  reg:
    maxItems: 1

  spi-max-frequency:
    maximum: 16000000

  interrupts:
    maxItems: 1

  interrupts-extended:
    maxItems: 1

  reset-gpios:
    maxItems: 1
    description: Active-low NRST, required for recovery from unresponsive IRQ/BUSY.

  busy-gpios:
    maxItems: 1
    description: Active-high BUSY.

  dio1-gpios:
    maxItems: 1
    description: Optional active-high individual DIO1 input before the OR gate.

  rxen-gpios:
    maxItems: 1
    description: Optional external receive enable, polarity follows GPIO flags.

  txen-gpios:
    maxItems: 1
    description: Optional external PA/transmit enable, polarity follows GPIO flags.

  semtech,frequency-min-hz:
    $ref: /schemas/types.yaml#/definitions/uint32
    minimum: 150000000
    maximum: 960000000
    description: Lower usable RF frequency of the module, including its RF matching.

  semtech,frequency-max-hz:
    $ref: /schemas/types.yaml#/definitions/uint32
    minimum: 150000000
    maximum: 960000000
    description: Upper usable RF frequency of the module, including its RF matching.

  semtech,tcxo-microvolt:
    $ref: /schemas/types.yaml#/definitions/uint32
    enum: [0, 1600000, 1700000, 1800000, 2200000, 2400000, 2700000, 3000000, 3300000]
    description: DIO3 TCXO supply voltage; zero selects a crystal. E22 default is 1800000.

  semtech,tcxo-startup-us:
    $ref: /schemas/types.yaml#/definitions/uint32
    maximum: 100000
    default: 5000
    description: TCXO startup time, rounded up to 64 kHz timer ticks.

  semtech,dio2-rf-switch:
    type: boolean
    description: Use DIO2 for automatic RF switch control, instead of RXEN/TXEN GPIOs.

  semtech,rf-switch-delay-us:
    $ref: /schemas/types.yaml#/definitions/uint32
    maximum: 10000
    default: 100
    description: Dead time between disabling and enabling external RF paths.

  semtech,pa-duty-cycle:
    $ref: /schemas/types.yaml#/definitions/uint32
    maximum: 4
    default: 4
    description: SX1262 SetPaConfig paDutyCycle value for this RF front end.

  semtech,pa-hp-max:
    $ref: /schemas/types.yaml#/definitions/uint32
    maximum: 7
    default: 7
    description: SX1262 SetPaConfig hpMax value.

  semtech,tx-ramp:
    $ref: /schemas/types.yaml#/definitions/uint32
    maximum: 7
    default: 4
    description: SetTxParams ramp enum (4 means 200 microseconds).

  semtech,regulator-mode:
    $ref: /schemas/types.yaml#/definitions/uint32
    enum: [0, 1]
    description: 0 for LDO, 1 for DC-DC. Default is LDO for bare SX1262, DC-DC for E22.

  semtech,tx-power-table:
    $ref: /schemas/types.yaml#/definitions/uint32-matrix
    minItems: 1
    maxItems: 32
    items:
      minItems: 3
      maxItems: 3
    description: |
      Rows of module-output-dBm, chip-SetTxParams-dBm, OCP-register-value.
      The first two cells are signed 32-bit two's-complement integers.
      Output range -40..40, chip range -9..22, OCP range 1..63. Only listed
      output powers are accepted. Describe measured amplifier characteristics
      here rather than assuming a constant gain. Without a table, bare SX1262
      exposes -9..22 dBm at the chip and E22 M30S uses the legacy 8..30 dBm
      mapping (chip power = output - 17, OCP 0x18 up to 22 dBm, then 0x38).

required:
  - compatible
  - reg
  - spi-max-frequency
  - reset-gpios
  - busy-gpios

allOf:
  - $ref: /schemas/spi/spi-peripheral-props.yaml#
  - oneOf:
      - required: [interrupts]
      - required: [interrupts-extended]
  - if:
      required: [semtech,dio2-rf-switch]
    then:
      properties:
        rxen-gpios: false
        txen-gpios: false

unevaluatedProperties: false

examples:
  - |
    #include <dt-bindings/gpio/gpio.h>
    #include <dt-bindings/interrupt-controller/irq.h>
    spi {
        #address-cells = <1>;
        #size-cells = <0>;
        radio@0 {
            compatible = "semtech,sx1262";
            reg = <0>;
            spi-max-frequency = <1000000>;
            interrupt-parent = <&gpio>;
            interrupts = <7 IRQ_TYPE_LEVEL_HIGH>;
            reset-gpios = <&gpio 8 GPIO_ACTIVE_LOW>;
            busy-gpios = <&gpio 9 GPIO_ACTIVE_HIGH>;
            semtech,frequency-min-hz = <410000000>;
            semtech,frequency-max-hz = <493000000>;
        };
    };
```

## buildroot/Config.in
```kconfig
menu "SX1262 Linux driver"
source "$BR2_EXTERNAL_SX1262_PATH/package/sx1262-linux/Config.in"
endmenu
```

## buildroot/package/sx1262-linux/Config.in
```kconfig
config BR2_PACKAGE_SX1262_LINUX
	bool "sx1262-linux"
	depends on BR2_LINUX_KERNEL
	help
	  Raw LoRa SPI SX1262 driver with shared IRQ, GPIO expanders,
	  packet receive queues and a global transmit queue.
	  Requires CONFIG_MODULES, CONFIG_SPI and CONFIG_GPIOLIB.
```
